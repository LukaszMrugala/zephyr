## boards/Kconfig.whisper
```kconfig
# Copyright (c) 2024 Intel Corporation
#
# SPDX-License-Identifier: Apache-2.0

if WHISPER_TARGET

config WHISPER_USE_CLINT
	bool "Pass --clint command line argument"
	help
	  This enables passing --clint command line argument to Whisper.

config WHISPER_CLINT_BASE_ADDRESS
	hex "Address for --clint command line argument"
	depends on WHISPER_USE_CLINT
	help
	  Specify the base address for used with --clint command
	  line argument.

endif # WHISPER_TARGET
```

## boards/cdns/swerv/Kconfig
```kconfig
# Copyright (c) 2024 Intel Corporation
#
# SPDX-License-Identifier: Apache-2.0

config BOARD_CDNS_SWERV_S400_WHISPER
```

## boards/cdns/swerv/Kconfig.cdns_swerv
```kconfig
# Copyright (c) 2024 Intel Corporation
#
# SPDX-License-Identifier: Apache-2.0

config BOARD_CDNS_SWERV_S400_WHISPER
	select SOC_FAMILY_CDNS_SWERV
	select SOC_CDNS_SWERV_S400

if BOARD_CDNS_SWERV_S400_WHISPER

# 15 in core RISC-V by MIE CSR
# 256 in SweRV PIC for external interrupts
config NUM_IRQS
	default 271

config SWERV_PIC_MAX_GENERIC_IRQ
	default 15

config WHISPER_TARGET
	default y

config WHISPER_USE_CLINT
	default y

config WHISPER_CLINT_BASE_ADDRESS
	default 0x02000000

endif # BOARD_CDNS_SWERV_S400_WHISPER
```

## boards/cdns/swerv/Kconfig.defconfig
```kconfig
# Copyright (c) 2024 Intel Corporation
#
# SPDX-License-Identifier: Apache-2.0

if BOARD_CDNS_SWERV_S400_WHISPER

config BUILD_OUTPUT_BIN
	default n

endif # BOARD_CDNS_SWERV_S400_WHISPER
```

## boards/cdns/swerv/board.yml
```yaml
board:
  name: cdns_swerv
  vendor: cdns
  socs:
    - name: s400
      variants:
        - name: whisper
```

## boards/cdns/swerv/cdns_swerv_s400_whisper_defconfig
```kconfig
# Copyright (c) 2024 Intel Corporation
#
# SPDX-License-Identifier: Apache-2.0

CONFIG_CONSOLE=y
CONFIG_SERIAL=y
CONFIG_WHISPER_CONSOLE=y
CONFIG_XIP=n

# Although there is some vague mentioning of whisper
# assuming CPU running at 1GHz, that is too fast
# which means any simulation will take forever to run.
# So lower it to 15MHz which corresponds to FPGA
# configuration in the build script.
CONFIG_SYS_CLOCK_HW_CYCLES_PER_SEC=15000000
CONFIG_SYS_CLOCK_TICKS_PER_SEC=100

# MRAC - Region Access Control CSR
#   0x0000_0000 - 0x0FFF_FFFF is cacheable
#   0x4000_0000 - 0x4FFF_FFFF has side-effect
#   0xF000_0000 - 0xFFFF_FFFF has side-effect
CONFIG_SOC_CDNS_SWERV_S400_BOOT_MRAC=0x80000201
```

## boards/intel/adsp/intel_adsp_ace30_ptl_fpga_defconfig
```kconfig
# SPDX-License-Identifier: Apache-2.0

CONFIG_MAIN_STACK_SIZE=2048
CONFIG_GEN_ISR_TABLES=y
CONFIG_GEN_IRQ_VECTOR_TABLE=n

CONFIG_BUILD_OUTPUT_BIN=n

CONFIG_DAI_SSP_HAS_POWER_CONTROL=y

CONFIG_DCACHE_LINE_SIZE=64

# FPGA cpu core clock is much slower (40-50MHz) and therefore
# needs a lower tick rate to pass tests where the tick rate determines
# success/failure scenarios
CONFIG_SYS_CLOCK_TICKS_PER_SEC=10000
```

## boards/intel/ish/Kconfig
```kconfig
# Copyright (c) 2024 Intel Corporation
#
# SPDX-License-Identifier: Apache-2.0

config BOARD_INTEL_ISH_5_4_1
	bool
        select SIMICS_TARGET if BOARD_INTEL_ISH_5_4_1_INTEL_ISH_5_4_1_SIMICS

config BOARD_INTEL_ISH_5_8_0
	bool
        select SIMICS_TARGET if BOARD_INTEL_ISH_5_8_0_INTEL_ISH_5_8_0_SIMICS
```

## boards/intel/ish/Kconfig.intel_ish_5_8_0
```kconfig
# Copyright (c) 2024 Intel Corporation
#
# SPDX-License-Identifier: Apache-2.0

config BOARD_INTEL_ISH_5_8_0
	select SOC_INTEL_ISH_5_8_0
	select SIMICS_TARGET if BOARD_INTEL_ISH_5_8_0_INTEL_ISH_5_8_0_SIMICS
```

## boards/intel/ish/intel_ish_5_4_1_simics_defconfig
```kconfig
#
# Copyright (c) 2023, Intel Corporation
#
# SPDX-License-Identifier: Apache-2.0
#
CONFIG_CONSOLE=y
CONFIG_UART_CONSOLE=y
CONFIG_SERIAL=y

# i2c
CONFIG_I2C=y

#GPIO
CONFIG_GPIO=y
```

## drivers/interrupt_controller/Kconfig.swerv
```kconfig
# Copyright (c) 2015, 2024 Intel Corporation
#
# SPDX-License-Identifier: Apache-2.0

config SWERV_PIC
	bool "Cadence SweRV Programmable Interrupt Controller (PIC)"
	default y
	depends on DT_HAS_CDNS_SWERV_PIC_ENABLED
	help
	  Programmable Interrupt Controller for the Cadence SweRV RISC-V CPU.
```

## drivers/timer/Kconfig.whisper
```kconfig
# Copyright (c) 2014-2015 Wind River Systems, Inc.
# Copyright (c) 2016 Cadence Design Systems, Inc.
# Copyright (c) 2019-2024 Intel Corp.
#
# SPDX-License-Identifier: Apache-2.0

config WHISPER_TIMER
	bool "Whisper Simulator Timer"
	default y
	depends on DT_HAS_WHISPER_TIMER_ENABLED
	select TICKLESS_CAPABLE
	help
	  This module implements a kernel device driver for the Whisper simulator
	  timer driver. It provides the standard "system clock driver" interfaces.

	  Note that, although the timer register and compare value are both
	  64-bit, writing to the upper 32-bit compare value will result it
	  overwriting the lower 32-bit compare value. So for now, this driver
	  is 32-bit only. Once the timer value goes above maximum value of
	  32-bit unsigned integer, writing the compare value will no longer
	  trigger any timer interrupt. This is a whisper bug which needs to be
	  fixed there before we can fully utilize 64-bit compare values.
```

## dts/bindings/timer/whisper,timer.yaml
```yaml
# Copyright (C) 2024 Intel Corporation
# SPDX-License-Identifier: Apache-2.0

description: |
  Whisper Simulator Timer

compatible: "whisper,timer"

include: base.yaml

properties:
  reg:
    required: true
    description: |
      Address and size of the register to write timer comparison value into.

  interrupts:
    required: true
```

## scripts/tests/twister_blackbox/test_data/boards/dummy_arch/dummy_platform/Kconfig.defconfig
```kconfig
# SPDX-License-Identifier: Apache-2.0

if BOARD_DUMMY

config BOARD
	default "dummy"

endif # BOARD_DUMMY
```

## soc/cdns/swerv/Kconfig
```kconfig
# Copyright (c) 2024 Intel Corporation
#
# SPDX-License-Identifier: Apache-2.0

config SOC_FAMILY_CDNS_SWERV
	select INCLUDE_RESET_VECTOR
	select RISCV

if SOC_FAMILY_CDNS_SWERV

rsource "*/Kconfig"

endif # SOC_FAMILY_CDNS_SWERV
```

## soc/cdns/swerv/Kconfig.defconfig
```kconfig
# Copyright (c) 2024 Intel Corporation
#
# SPDX-License-Identifier: Apache-2.0

# Leaving this blank on purpose.
# Do default configs in each SoC instead.

rsource "*/Kconfig.defconfig"
```

## soc/cdns/swerv/s400/Kconfig.soc
```kconfig
# Copyright (c) 2024 Intel Corporation
#
# SPDX-License-Identifier: Apache-2.0

config SOC_CDNS_SWERV_S400
	bool
	select SOC_FAMILY_CDNS_SWERV

config SOC
	default "s400" if SOC_CDNS_SWERV_S400

if SOC_CDNS_SWERV_S400

config SOC_CDNS_SWERV_S400_BOOT_MRAC
	hex "Set MRAC CSR value at boot"
	help
	  Setup the MRAC CSR register for region access control
	  on caching and side effect settings.

endif # SOC_CDNS_SWERV_S400
```

## soc/intel/intel_ish/Kconfig
```kconfig
# Intel ISH family configuration options
#
# Copyright (c) 2023-2024 Intel Corporation
#
# SPDX-License-Identifier: Apache-2.0

config SOC_FAMILY_INTEL_ISH
	select X86
	select X86_NO_SPECULATIVE_VULNERABILITIES
	select IOAPIC
	select LOAPIC
	select CPU_HAS_FPU
	select CPU_HAS_DCACHE
	select INTEL_HAL
	select HAS_PM if !BOARD_INTEL_ISH_5_4_1_SIMICS && !BOARD_INTEL_ISH_5_8_0_SIMICS
	select HAS_COVERAGE_SUPPORT
	select SOC_EARLY_INIT_HOOK
```
